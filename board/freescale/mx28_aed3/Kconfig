## board/freescale/mx28_aed3/Kconfig
```kconfig
if TARGET_MX28_AED3

config SYS_BOARD
	default "mx28_aed3"

config SYS_VENDOR
	default "freescale"

config SYS_SOC
	default "mxs"

config SYS_CONFIG_NAME
	default "mx28_aed3"

endif
```

## board/freescale/mx6ul_m30/Kconfig
```kconfig
if TARGET_MX6UL_M30

config SYS_BOARD
	default "mx6ul_m30"

config SYS_VENDOR
	default "freescale"

config SYS_CONFIG_NAME
	default "mx6ul_m30"

endif
```

## configs/mx28_aed3_defconfig
```kconfig
CONFIG_ARM=y
CONFIG_ARCH_MX28=y
CONFIG_SYS_TEXT_BASE=0x40002000
CONFIG_SPL_GPIO_SUPPORT=y
CONFIG_SPL_LIBCOMMON_SUPPORT=y
CONFIG_SPL_LIBGENERIC_SUPPORT=y
CONFIG_TARGET_MX28_AED3=y
CONFIG_SPL_SERIAL_SUPPORT=y
CONFIG_NR_DRAM_BANKS=1
CONFIG_SPL=y
# CONFIG_CONSOLE_MUX is not set
CONFIG_SYS_CONSOLE_IS_IN_ENV=y
CONFIG_VERSION_VARIABLE=y
# CONFIG_DISPLAY_BOARDINFO is not set
CONFIG_ARCH_MISC_INIT=y
# CONFIG_SPL_FRAMEWORK is not set
CONFIG_SPL_TEXT_BASE=0x00001000
CONFIG_HUSH_PARSER=y
CONFIG_MTDIDS_DEFAULT="nand0=gpmi-nand"
CONFIG_MTDPARTS_DEFAULT="mtdparts=gpmi-nand:3m(bootloader)ro,512k(environment),512k(redundant-environment),4m(kernel),512k(fdt),8m(ramdisk),-(filesystem)"
CONFIG_ENV_IS_IN_NAND=y
CONFIG_MMC_MXS=y
CONFIG_NAND=y
CONFIG_NAND_MXS=y
CONFIG_MII=y
CONFIG_CONS_INDEX=0
```

## configs/mx6ul_m30_defconfig
```kconfig
CONFIG_ARM=y
CONFIG_ARCH_MX6=y
CONFIG_TARGET_MX6UL_M30=y
CONFIG_SYS_EXTRA_OPTIONS="IMX_CONFIG=board/freescale/mx6ul_m30/imximage.cfg"
CONFIG_FIT=y
# CONFIG_FIT_VERBOSE is not set
# CONFIG_SYS_MALLOC_CLEAR_ON_INIT is not set

#
# Info commands
#
# CONFIG_CMD_BDI is not set
# CONFIG_CMD_CONSOLE is not set

#
# Boot commands
#
# CONFIG_CMD_BOOTD is not set
CONFIG_CMD_BOOTM=y
# CONFIG_CMD_ELF is not set
# CONFIG_CMD_GO is not set
# CONFIG_CMD_RUN is not set
# CONFIG_CMD_IMI is not set
# CONFIG_CMD_IMLS is not set
# CONFIG_CMD_XIMG is not set

#
# Environment commands
#
# CONFIG_CMD_EXPORTENV is not set
# CONFIG_CMD_IMPORTENV is not set
# CONFIG_CMD_EDITENV is not set

#
# Memory commands
#
# CONFIG_CMD_MEMORY is not set
# CONFIG_CMD_CRC32 is not set

#
# Device access commands
#
# CONFIG_CMD_DM is not set
# CONFIG_CMD_LOADB is not set
# CONFIG_CMD_LOADS is not set
# CONFIG_CMD_FLASH is not set
# CONFIG_CMD_FPGA is not set
# CONFIG_CMD_GPIO is not set

#
# Network commands
#
# CONFIG_CMD_NET is not set
# CONFIG_CMD_DHCP is not set
# CONFIG_CMD_NFS is not set
# CONFIG_CMD_PING is not set

#
# Misc commands
#
# CONFIG_CMD_MISC is not set
```
